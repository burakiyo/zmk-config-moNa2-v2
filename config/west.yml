## config/west.yml
```yaml
manifest:
  remotes:
    - name: zmkfirmware
      url-base: https://github.com/zmkfirmware
    - name: sayu-hub
      url-base: https://github.com/sayu-hub
    - name: badjeff    # <-- PMW3610
      url-base: https://github.com/badjeff
    # - name: sekigon-gonnoc  # <-- PAW3222
    #   url-base: https://github.com/sekigon-gonnoc
    - name: caksoylar  # <-- RGB LED
      url-base: https://github.com/caksoylar  
    - name: zettaface  # <-- Input Processor Keybind
      url-base: https://github.com/zettaface
  projects:
    - name: zmk
      remote: zmkfirmware
      revision: v0.3.0
      import: app/west.yml
    - name: zmk-pmw3610-driver
      remote: badjeff
      revision: zmk-0.3
    # - name: zmk-driver-paw3222
    #   remote: sekigon-gonnoc
    #   revision: main
    - name: zmk-rgbled-widget
      remote: caksoylar
      revision: a3510c9de46de8b42c803286f4978466c6ea3916  # 2026-02-01 時点の main
    - name: zmk-input-processor-keybind
      remote: zettaface
      revision: main
  self:
    path: config
```

## modules/ble_mouse_coalesce/Kconfig
```kconfig
config MONA2_BLE_MOUSE_COALESCE
    bool "Coalesce BLE mouse reports instead of queueing them"
    depends on ZMK_BLE && ZMK_POINTING
    depends on !ZMK_SPLIT || ZMK_SPLIT_ROLE_CENTRAL
    help
      Replaces ZMK's BLE mouse sender. Keeps only a few mouse notifications
      inside the Bluetooth stack and folds further motion into the newest
      unsent report, so the cursor never replays stale motion when the host
      polls the link slower than the sensor reports.

if MONA2_BLE_MOUSE_COALESCE

config MONA2_BLE_MOUSE_COALESCE_MAX_IN_FLIGHT
    int "Mouse notifications handed to the Bluetooth stack at once"
    default 2
    range 1 8

config MONA2_BLE_MOUSE_COALESCE_SLOTS
    int "Unsent mouse reports kept apart (one per button change)"
    default 8
    range 2 32

config MONA2_BLE_MOUSE_COALESCE_STALL_MS
    int "Stop waiting for a lost send completion after this many ms"
    default 500

endif
```
